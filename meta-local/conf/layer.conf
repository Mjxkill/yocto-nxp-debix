## meta-local/conf/layer.conf
```bitbake
# Meta layer for local customizations

BBPATH:prepend := "${LAYERDIR}/:"
BBFILES += "${LAYERDIR}/recipes-*/*/*.bb \
            ${LAYERDIR}/recipes-*/*/*.bbappend"

BBFILE_COLLECTIONS += "local"
BBFILE_PATTERN_local := "^${LAYERDIR}/"
BBFILE_PRIORITY_local = "1"

LAYERSERIES_COMPAT_local = "scarthgap"
```

## sources/meta-flutter/conf/layer.conf
```bitbake
# Meta-flutter layer configuration
BBPATH .= ":${LAYERDIR}"
BBFILES += "${LAYERDIR}/recipes-*/*/*.bb"
BBFILE_COLLECTIONS += "flutter"
BBFILE_PATTERN_flutter := "^${LAYERDIR}/"
BBFILE_PRIORITY_flutter = "6"
LAYERSERIES_COMPAT_flutter = "styhead"
```
